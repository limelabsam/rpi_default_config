## conf/bblayers.conf
```bitbake
# POKY_BBLAYERS_CONF_VERSION is increased each time build/conf/bblayers.conf
# changes incompatibly
POKY_BBLAYERS_CONF_VERSION = "2"

BBPATH = "${TOPDIR}"
BBFILES ?= ""

BBLAYERS ?= ""
BBLAYERS += "/home/smandy/Documents/rpi-repo/sources/meta"
BBLAYERS += "/home/smandy/Documents/rpi-repo/sources/meta-poky"
BBLAYERS += "/home/smandy/Documents/rpi-repo/sources/meta-yocto-bsp"
BBLAYERS += "/home/smandy/Documents/rpi-repo/sources/meta"
BBLAYERS += "/home/smandy/Documents/rpi-repo/sources/meta-poky"
BBLAYERS += "/home/smandy/Documents/rpi-repo/sources/meta-qt5"
BBLAYERS += "/home/smandy/Documents/rpi-repo/sources/meta-raspberrypi"
BBLAYERS += "/home/smandy/Documents/rpi-repo/sources/meta-rpi"
BBLAYERS += "/home/smandy/Documents/rpi-repo/sources/meta-selftest"
BBLAYERS += "/home/smandy/Documents/rpi-repo/sources/meta-skeleton"
BBLAYERS += "/home/smandy/Documents/rpi-repo/sources/meta-update"
BBLAYERS += "/home/smandy/Documents/rpi-repo/sources/meta-yocto"
# BBLAYERS += "/home/smandy/Documents/rpi-repo/sources/meta-yocto-bs"
BBLAYERS += "/home/smandy/Documents/rpi-repo/sources/meta-openembedded/meta-oe"
BBLAYERS += "/home/smandy/Documents/rpi-repo/sources/meta-openembedded/meta-multimedia"
BBLAYERS += "/home/smandy/Documents/rpi-repo/sources/meta-openembedded/meta-networking"
BBLAYERS += "/home/smandy/Documents/rpi-repo/sources/meta-openembedded/meta-python"
```
